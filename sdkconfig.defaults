## sdkconfig.defaults
```kconfig
# ESP32-S3 Configuration
CONFIG_IDF_TARGET="esp32s3"

# ============================================================================
# CPU: 240MHz
# ============================================================================
CONFIG_ESP_DEFAULT_CPU_FREQ_MHZ_240=y
CONFIG_ESP_DEFAULT_CPU_FREQ_MHZ=240

# ============================================================================
# Flash: QIO 80MHz, 16MB (máximo suportado pelo esptool)
# ============================================================================
CONFIG_ESPTOOLPY_FLASHMODE_QIO=y
CONFIG_ESPTOOLPY_FLASHFREQ_80M=y
CONFIG_ESPTOOLPY_FLASHSIZE_16MB=y

# ============================================================================
# PSRAM: OPI (Octal) 80MHz
# ============================================================================
CONFIG_SPIRAM=y
CONFIG_SPIRAM_MODE_OCT=y
CONFIG_SPIRAM_SPEED_80M=y
CONFIG_SPIRAM_BOOT_INIT=y
CONFIG_SPIRAM_USE_MALLOC=y

# ============================================================================
# USB CDC On Boot
# ============================================================================
CONFIG_ESP_CONSOLE_USB_CDC=y
CONFIG_ESP_CONSOLE_SECONDARY_NONE=y

# ============================================================================
# Partições: Dual OTA (3MB x2 + 1MB SPIFFS + 64KB NVS)
# ============================================================================
CONFIG_PARTITION_TABLE_CUSTOM=y
CONFIG_PARTITION_TABLE_CUSTOM_FILENAME="partitions.csv"

# ============================================================================
# FreeRTOS
# ============================================================================
CONFIG_FREERTOS_HZ=1000

# ============================================================================
# LCD/SPI
# ============================================================================
CONFIG_LCD_PANEL_IO_FORMAT_BUF_SIZE=64

# ============================================================================
# LittleFS
# ============================================================================
CONFIG_LITTLEFS_MAX_PARTITIONS=3

# ============================================================================
# Logs - reduzir em produção
# ============================================================================
CONFIG_LOG_DEFAULT_LEVEL_INFO=y

# ============================================================================
# Otimizações
# ============================================================================
CONFIG_COMPILER_OPTIMIZATION_SIZE=y

# ============================================================================
# I2S
# ============================================================================
CONFIG_I2S_ISR_IRAM_SAFE=y

# ============================================================================
# OTA Support
# ============================================================================
CONFIG_BOOTLOADER_APP_ROLLBACK_ENABLE=y
CONFIG_BOOTLOADER_FACTORY_RESET=n

# ============================================================================
# NVS
# ============================================================================
CONFIG_NVS_ENCRYPTION=n

# ============================================================================
# BLE / NimBLE
# ============================================================================
CONFIG_BT_ENABLED=y
CONFIG_BT_NIMBLE_ENABLED=y
CONFIG_BT_NIMBLE_ROLE_PERIPHERAL=y
CONFIG_BT_NIMBLE_ROLE_BROADCASTER=y
CONFIG_BT_NIMBLE_ROLE_CENTRAL=n
CONFIG_BT_NIMBLE_ROLE_OBSERVER=n
CONFIG_BT_NIMBLE_MAX_CONNECTIONS=1
CONFIG_BT_NIMBLE_SM_LEGACY=n
CONFIG_BT_NIMBLE_SM_SC=y
CONFIG_BT_NIMBLE_NVS_PERSIST=y
CONFIG_BT_NIMBLE_MAX_BONDS=3
CONFIG_BT_NIMBLE_PINNED_TO_CORE_0=y
CONFIG_BT_NIMBLE_HOST_TASK_STACK_SIZE=4096
CONFIG_BT_NIMBLE_ATT_PREFERRED_MTU=512
CONFIG_BT_NIMBLE_MSYS_1_BLOCK_COUNT=12
CONFIG_BT_NIMBLE_MSYS_1_BLOCK_SIZE=256
CONFIG_BT_NIMBLE_MSYS_2_BLOCK_COUNT=24
CONFIG_BT_NIMBLE_MSYS_2_BLOCK_SIZE=320
CONFIG_BT_NIMBLE_LOG_LEVEL_WARNING=y
CONFIG_BT_NIMBLE_EXT_ADV=n
CONFIG_BT_NIMBLE_50_FEATURE_SUPPORT=n
```
